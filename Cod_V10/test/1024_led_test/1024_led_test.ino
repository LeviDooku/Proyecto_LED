/* 
  ******************************************************
  * 1024_led_test.ino                                  *
  * Proyecto: Señal LED - V0.1                         *
  * Autores:                                           *
  *   - David Jándula Sánchez                          *
  *   - Pedro Velasco Santana                          *
  *                                                    *
  * Granada - 2024                                     *
  ******************************************************
*/

/* 
  Esquema de conexiones de los paneles (64x16 LEDs):

    Fila 1: [P0]  → [P1]
    Fila 2: [P3]  ← [P2]

    Flujo de datos: Zigzag vertical (Top-to-Bottom)
    Conexión inicial: Panel P0 (esquina superior izquierda)
*/

/*
Resumen de funcionamiento:

Programa que muestra un frame en una matriz 64x16 montada. Objetivo:
Comprobar que el envío de datos a la matriz es el correcto.
*/

#include <FastLED.h>
#include <IRremoteESP8266.h>

#define NUM_LEDS 1024
#define DATA_PIN 4

CRGB leds[NUM_LEDS];

//Frame

//Config en LEDMatrix Studio: Columns; Left to Right , Top to Bottom 

// =================================================================
// LED Matrix Studio - (c) Paul A Freshney 2024
// 
// https://github.com/MaximumOctopus/LEDMatrixStudio
// 
// Date : 2024/12/18
// 
// -----------------------------------------------------------------
// Original file:
//  Z:\home\david\dev\Proyecto_LED\Senial_50\Senial50_4.leds
// 
// =================================================================
// 
// Animation Frame #1
// Rows #1 - #64
// 
// =================================================================
// 
// Source : Rows
// Line   : Row
// Bits   : LSB at left
// Order  : Top to bottom
// Scan   : Left to right
// Size   : 32 bits
// 
// Colour Format: RGB
// Brightness   : 100%
// Colour Space : 32 bits
// 
// =================================================================
// 
// =================================================================
// LED Matrix Studio - (c) Paul A Freshney 2024
// 
// https://github.com/MaximumOctopus/LEDMatrixStudio
// 
// Date : 2024/12/18
// 
// -----------------------------------------------------------------
// Original file:
//  Z:\home\david\dev\Proyecto_LED\Senial_50\Senial50_4.leds
// 
// =================================================================
// 
// Animation Frame #1
// Rows #1 - #64
// 
// =================================================================
// 
// Source : Rows
// Line   : Row
// Bits   : LSB at right
// Order  : Top to bottom
// Scan   : Left to right
// Size   : 32 bits
// 
// Colour Format: RGB
// Brightness   : 100%
// Colour Space : 32 bits
// 
// =================================================================
// 

const uint32_t ledarray0[] PROGMEM = {
0x00000000, 0x00000000, 0x00000000, 0x00000000, 0x00000000, 0x00000000, 0x00000000, 0x00000000, 0x00000000, 0x00000000, 0x00000000, 0x00000000,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 0x00000000, 
0x00000000, 0x00000000, 0x00000000, 0x00000000, 0x00000000, 0x00000000, 0x00000000, 0x00000000, 0x00000000, 0x00000000, 0x00000000, 0x00000000,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 0x00000000, 
0x00000000, 0x00000000, 0x00000000, 0x00000000, 0x00000000, 0x00000000, 0x00000000, 0x00000000, 0x00000000, 0x00000000, 0x00000000, 0x00000000,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 0x00000000, 
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0x00000000, 0x00000000, 0x00000000, 0x00000000, 0x00000000, 0x00000000, 0x00000000, 0x00000000, 0x00000000, 0x00000000, 0x00000000, 0x00000000,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 0x00000000, 
};

// 
// =================================================================
// 


// 
// =================================================================
// 


// dimensiones imagen
#define WIDTH           64
#define HEIGHT          64

// dimensiones paneles
#define PANEL_WIDTH     8
#define PANEL_HEIGHT    32

int width = WIDTH;
int height = HEIGHT;
int panel_width = PANEL_WIDTH;
int panel_height = PANEL_HEIGHT;

int transform(int i, int j) {
    int x = 0;

    // columnas impares
    if ((j/panel_width)%2) x = (panel_width*height*(j/panel_width)+1)+panel_width*i+panel_width-2;

    // columnas pares
    else x = (panel_width*height*(j/panel_width+1)-1)-panel_width*i;

    // filas impares
    if (i%2) x += (j%panel_width)-panel_width+1;

    // filas pares
    else x += -(j%panel_width);

    return x;
}


void setup() {
  FastLED.addLeds<NEOPIXEL, DATA_PIN>(leds, NUM_LEDS);
}

void loop() {
  /*
  for (int i = 0; i < NUM_LEDS; i++) {
    leds[i] = frame0[i]; 
  }
  */

  for (int x = 0; x < 4; x++) {
    for (int i = 0; i < HEIGHT; i++) {
        for (int j = 0; j < WIDTH/4; j++) {
            leds[transform(i, j)] = ledarray0[i*WIDTH+(j+x*WIDTH/4)];
        }
    }
    FastLED.show();
    delay(1500);
  }
}
