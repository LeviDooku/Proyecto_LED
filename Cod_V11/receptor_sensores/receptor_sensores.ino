/* 
  ******************************************************
  * sensor_luz.ino                                    *
  * Proyecto: Señal LED - V0.1                         *
  * Autores:                                           *
  *   - David Jándula Sánchez                          *
  *   - Pedro Velasco Santana                          *
  *                                                    *
  * Granada - 2025                                     *
  ******************************************************
*/

#include <LiquidCrystal.h>
#include <IRremoteESP8266.h>
#include <IRtimer.h>
#include <IRrecv.h>
#include <FastLED.h>
#include "DHT.h"

#define DHTTYPE DHT11 // DHT 11

//Config LED's
#define NUM_LEDS 256*4

#define D0 16
#define D1 5
#define D2 4
#define D3 0
#define D4 2
#define D5 14
#define D6 12
#define D7 13
#define D8 15

#define LED_PIN D4
#define IR_PIN D3
#define DHT_PIN D2

CRGB leds[NUM_LEDS];

// Config Frame

// Source : Rows
// Line   : Row
// Bits   : LSB at right
// Order  : Top to bottom
// Scan   : Left to right
// Size   : 32 bits
// 
// Colour Format: RGB
// Brightness   : 100%
// Colour Space : 32 bits

uint32_t ledarray0[] PROGMEM = {
0xFF0000, 0xFF0000, 0xFF0000, 0xFF0000, 0xFF0000, 0xFF0000, 0xFF0000, 0xFF0000, 
0x00000000, 0x00000000, 0x00000000, 0x00000000, 0x00000000, 0x00000000, 0x00000000, 0x00000000, 
0x00000000, 0x00000000, 0x00000000, 0x00000000, 0x00000000, 0x00000000, 0x00000000, 0x00000000, 
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0x00000000, 0x00000000, 0x00000000, 0x00000000, 0x00000000, 0x00000000, 0x00000000, 0x00000000, 
};

uint32_t ledarray1[] PROGMEM = {
0xFF0000, 0xFF0000, 0xFF0000, 0xFF0000, 0xFF0000, 0xFF0000, 0xFF0000, 0xFF0000, 
0x00000000, 0x00000000, 0x00000000, 0x00000000, 0x00000000, 0x00000000, 0x00000000, 0x00000000, 
0x00000000, 0x00000000, 0x00000000, 0x00000000, 0x00000000, 0x00000000, 0x00000000, 0x00000000, 
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0x00000000, 0x00000000, 0x00000000, 0x00000000, 0x00000000, 0x00000000, 0x00000000, 0x00000000, 
};

uint32_t ledarray2[] PROGMEM = {
0x00000000, 0x00000000, 0x00000000, 0x00000000, 0x00000000, 0x00000000, 0x00000000, 0x00000000, 
0x00000000, 0x00000000, 0x00000000, 0x00000000, 0x00000000, 0x00000000, 0x00000000, 0x00000000, 
0x00000000, 0x00000000, 0x00FF00FF, 0x00000000, 0x00000000, 0x00000000, 0x00000000, 0x00000000, 
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0x00000000, 0x00000000, 0x00000000, 0x00000000, 0x00FFF000, 0x00000000, 0x00000000, 0x00000000, 
};

// dimensiones imagen
#define WIDTH           8
#define HEIGHT          32

// dimensiones paneles
#define PANEL_WIDTH     8
#define PANEL_HEIGHT    32

int width = WIDTH;
int height = HEIGHT;
int panel_width = PANEL_WIDTH;
int panel_height = PANEL_HEIGHT;

// datos del sensor IR
IRrecv irrecv(IR_PIN);
decode_results results;

// datos del sensor DHT11
DHT dht(DHT_PIN, DHTTYPE);
float temperature;

// datos de la pantalla LCD
LiquidCrystal lcd(D0,D1,D5,D6,D7,D8);

/* TODO: eliminar el uso de esta variable */
int numLeds = 1;
int var = 8;

int transform(int i, int j) {
    int x = 0;

    // columnas impares
    if ((j/panel_width)%2) x = (panel_width*height*(j/panel_width)+1)+panel_width*i+panel_width-2;

    // columnas pares
    else x = (panel_width*height*(j/panel_width+1)-1)-panel_width*i;

    // filas impares
    if (i%2) x += (j%panel_width)-panel_width+1;

    // filas pares
    else x += -(j%panel_width);

    return x;
}

int sensorValue;
int sensorLow = 1023;
int sensorHigh = 0;

void imprimeMensaje(String mensaje, int col, int row){
    lcd.setCursor(col,row);
    lcd.print(mensaje);
}

void setup() {
    Serial.begin(115200);
    FastLED.addLeds<NEOPIXEL, LED_PIN>(leds, NUM_LEDS);
    FastLED.clear();
    
    // LCD
    lcd.begin(16, 2);
    lcd.home();
    lcd.print("[+] INICIANDO");
    lcd.setCursor(0,1);
    lcd.print("[+] SISTEMA");
    
    // IR
    irrecv.enableIRIn();

    // DHT11
    pinMode(DHT_PIN, INPUT);   
    dht.begin();

    delay(1000);
}



typedef struct {
    int brightness;
    float temperature;
    int frame;
} sensor_data;

sensor_data sensors = {25, 0, 0};

void loop() {
    // leer mando
    if (irrecv.decode(&results)) {
      Serial.print("Código recibido: ");
      Serial.println(results.value, HEX); // Imprime el código en formato hexadecimal
      irrecv.resume(); // Prepara el receptor para el siguiente valor
      if (results.value == 0xFFA25D) sensors.frame = 0;
      if (results.value == 0xFF629D) sensors.frame = 1;
      if (results.value == 0xFFE21D) sensors.frame = 2;
      if (results.value == 0xFF22DD) sensors.frame = 3;      
      if (results.value == 0xFFE01F) sensors.brightness = 25;
      if (results.value == 0xFFA857) sensors.brightness = 50;
      if (results.value == 0xFF906F) sensors.brightness = 100;
      if (results.value == 0xFF18E7) numLeds = numLeds+var;
      if (results.value == 0xFF4AB5) numLeds = numLeds-var;
      if (results.value == 0xFF5AA5) if (var < 100) var += 1;
      if (results.value == 0xFF10EF) if (var > 0) var -= 1;
    }

    // leer temperatura
    sensors.temperature = dht.readTemperature();

    // leer iluminación
    // TO-DO

    // mostrar datos en puerto serie
    Serial.print("[+] frame: ");
    Serial.print(sensors.frame);
    Serial.print(" temperature: ");
    Serial.print(sensors.temperature);
    Serial.print(" brightness: ");
    Serial.println(sensors.brightness);
    Serial.print(" var: ");
    Serial.println(var);    
    Serial.print(" numLeds: ");
    Serial.println(numLeds);

    // mostrar datos en LCD
    lcd.clear();
    imprimeMensaje("[+] Temp: "  + String(sensors.temperature)+"C", 0, 0);
    imprimeMensaje("Foto " + String(sensors.frame) + " Luz " + String(sensors.brightness), 0, 1);

    // representar imagen
    FastLED.clear();
    /*TODO: poner HEIGHT y WIDTH de nuevo */
    /*
    for (int i = 0; i < numLeds; i++) {
        for (int j = 0; j < 1; j++) {
            if (sensors.frame == 0) 
              leds[transform(i, j)] = CRGB::Red;// pgm_read_dword(&ledarray0[i * WIDTH + j]);
            else if (sensors.frame == 1)
              leds[transform(i, j)] = CRGB::Green; // pgm_read_dword(&ledarray1[i * WIDTH + j]);
            else if (sensors.frame == 2)
              leds[transform(i, j)] = CRGB::Blue; // pgm_read_dword(&ledarray2[i * WIDTH + j]);
            else
              leds[transform(i, j)] = CRGB::White; // pgm_read_dword(&ledarray2[i * WIDTH + j]);
        }
    }*/
    for (int i = 0; i < numLeds; i++) {
            if (sensors.frame == 0) 
              leds[i] = CRGB::Red;// pgm_read_dword(&ledarray0[i * WIDTH + j]);
            else if (sensors.frame == 1)
              leds[i] = CRGB::Green; // pgm_read_dword(&ledarray1[i * WIDTH + j]);
            else if (sensors.frame == 2)
              leds[i] = CRGB::Blue; // pgm_read_dword(&ledarray2[i * WIDTH + j]);
            else
              leds[i] = CRGB::White; // pgm_read_dword(&ledarray2[i * WIDTH + j]);
    }

    FastLED.show();

    // ajustar el brillo
    FastLED.setBrightness(sensors.brightness);

    delay(250);
}
