/* 
  ******************************************************
  * Controlador.ino                                    *
  * Proyecto: Señal LED -                              *
  * Autores:                                           *
  *   - David Jándula Sánchez                          *
  *   - Pedro Velasco Santana                          *
  *                                                    *
  * Granada - 2025                                     *
  ******************************************************
*/

/* librerías */
#include <LiquidCrystal.h>
#include <IRremoteESP8266.h>
#include <IRtimer.h>
#include <IRrecv.h>
#include <FastLED.h>
#include "DHT.h"
#include "img_reduzca.h"
#include "img_trafico.h"
#include "img_velocidad.h"

#define D0 16
#define D1 5
#define D2 4
#define D3 0
#define D4 2
#define D5 14
#define D6 12
#define D7 13
#define D8 15

/* configuración de los LED */
// dimensiones imagen
#define WIDTH           64
#define HEIGHT          64

// dimensiones paneles
#define PANEL_WIDTH     8
#define PANEL_HEIGHT    32
#define NUM_LEDS WIDTH*HEIGHT

/* pines de los sensores/actuadores */
#define LED_PIN D4
#define IR_PIN D3
#define DHT_PIN D2
#define DHTTYPE DHT11 // DHT 11

/* matriz de LEDs */
CRGB leds[NUM_LEDS];



const uint32_t ledarray1[] PROGMEM = {
    0x00000000, 0x00000000, 0x00000000, 0x00000000, 0x00000000, 0x00000000, 0x00000000, 0x00000000, 0x00000000, 0x00000000, 0x00000000, 0x00000000,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 0x00000000, 
    0x00000000, 0x00000000, 0x00000000, 0x00000000, 0x00000000, 0x00000000, 0x00000000, 0x00000000, 0x00000000, 0x00000000, 0x00000000, 0x00000000,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 0x00000000, 
    0x00000000, 0x00000000, 0x00000000, 0x00000000, 0x00000000, 0x00000000, 0x00000000, 0x00000000, 0x00000000, 0x00000000, 0x00000000, 0x00000000,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 0x00000000, 
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    0x00000000, 0x00000000, 0x00000000, 0x00000000, 0x00000000, 0x00000000, 0x00000000, 0x00000000, 0x00000000, 0x00000000, 0x00000000, 0x00000000,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 0x00000000, 
};

const uint32_t ledarray2[] PROGMEM = {
    0x000000, 0x000000, 0x000000, 0x000000, 0x000000, 0x000000, 0x000000, 0x000000, 0x000000, 0x000000, 0x000000, 0x000000, 0x000000, 0x000000, 0x000000,
    0x000000, 0x000000, 0x000000, 0x000000, 0x000000, 0x000000, 0x000000, 0x000000, 0x000000, 0x000000, 0x000000, 0x000000, 0x000000, 0x000000, 0x000000,
    0x000000, 0x000000, 0x000000, 0x000000, 0x000000, 0x000000, 0x000000, 0x000000, 0x000000, 0x000000, 0x000000, 0x000000, 0x000000, 0x000000, 0x000000,
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    0x000000,
};


int width = WIDTH;
int height = HEIGHT;
int panel_width = PANEL_WIDTH;
int panel_height = PANEL_HEIGHT;

// datos del sensor IR
IRrecv irrecv(IR_PIN);
decode_results results;

// datos del sensor DHT11
DHT dht(DHT_PIN, DHTTYPE);
float temperature;

// datos de la pantalla LCD
LiquidCrystal lcd(D0,D1,D5,D6,D7,D8);


/* adapta la imagen a la disposición de los paneles */
int transform(int i, int j) {
    int x = 0;

    // columnas impares
    if ((j/panel_width)%2) x = (panel_width*height*(j/panel_width)+1)+panel_width*i+panel_width-2;

    // columnas pares
    else x = (panel_width*height*(j/panel_width+1)-1)-panel_width*i;

    // filas impares
    if (i%2) x += (j%panel_width)-panel_width+1;

        // filas pares
    else x += -(j%panel_width);

    return x;
}

/* funciones del sensor */
int sensorValue;
int sensorLow = 1023;
int sensorHigh = 0;

/* imprime un mensaje en la pantalla LCD */
void imprimeMensaje(String mensaje, int col, int row){
    lcd.setCursor(col,row);
    lcd.print(mensaje);
}

void setup() {
    delay(5000);
    Serial.begin(115200);
    FastLED.addLeds<NEOPIXEL, LED_PIN>(leds, NUM_LEDS);
    FastLED.clear();

    // LCD
    lcd.begin(16, 2);
    lcd.home();
    lcd.print("[+] INICIANDO");
    lcd.setCursor(0,1);
    lcd.print("[+] SISTEMA");

    // IR
    irrecv.enableIRIn();

    // DHT11
    pinMode(DHT_PIN, INPUT);   
    dht.begin();

    delay(1000);
}

typedef struct {
    int brightness;
    float temperature;
    int frame;
} sensor_data;

sensor_data sensors = {25, 0, 0};
unsigned int x = 0;
bool play = true;
void loop() {
    // leer mando
    if (irrecv.decode(&results)) {
        Serial.print("Código recibido: ");
        Serial.println(results.value, HEX); // Imprime el código en formato hexadecimal
        irrecv.resume(); // Prepara el receptor para el siguiente valor
        if (results.value == 0xFFA25D) { sensors.frame = 1; x = 0; }/* señal 50 */
        if (results.value == 0xFF629D) { sensors.frame = 3; x = 0; } /* señal obrero */
        if (results.value == 0xFFE21D) { sensors.frame = 5; x = 0; }/* reduzca velocidad */
        if (results.value == 0xFFE01F) sensors.brightness = 10;
        if (results.value == 0xFFA857) sensors.brightness = 50;
        if (results.value == 0xFF906F) sensors.brightness = 100;
        if (results.value == 0xFF9867) play = !play;
    }

    // leer temperatura
    sensors.temperature = dht.readTemperature();

    // mostrar datos en LCD
    lcd.clear();
    imprimeMensaje("[+] Temp: "  + String(sensors.temperature)+"C", 0, 0);
    if (!play) imprimeMensaje("Luz: " + String(sensors.brightness) + " Pausado", 0, 1);
    else imprimeMensaje("Luz: " + String(sensors.brightness), 0, 1);

    // representar imagen
    // FastLED.clear();

    /* destello azul */
    if (sensors.frame == 0 || sensors.frame == 2 || sensors.frame == 4) {
        for (int i = 0; i < width; i++)
            for (int j = 0; j < height; j++)
                leds[i+j*width] = CRGB::Blue;

        FastLED.show();
        FastLED.clear();

        x += 1;
        if (x == 5) {
            x = 0;
            sensors.frame++;
        }
    }

    /* señal 50 */
    else if (sensors.frame == 1) {
        if (x == 0) {
            for (int i = 0; i < width; i++)
                for (int j = 0; j < height; j++)
                    leds[transform(i, j)] = pgm_read_dword(&ledarray1[i * WIDTH + j]);
        }
        x++;
        if (x > 30 && play) {
            x = 0;
            sensors.frame++;
        }
    }

    /* señal obras */
    else if (sensors.frame == 3) {
        if (x == 0) {
            for (int i = 0; i < width; i++)
                for (int j = 0; j < height; j++)
                    leds[transform(i, j)] = pgm_read_dword(&img_trafico[i * WIDTH + j]);
        }
        x++;
        if (x > 30 && play) {
            x = 0;
            sensors.frame++;
        }
    }

    /* reduzca velocidad */
    else if (sensors.frame == 5) {
        if (x == 0) {
            for (int i = 0; i < width; i++)
                for (int j = 0; j < height; j++)
                    leds[transform(i, j)] = pgm_read_dword(&img_velocidad[i * WIDTH + j]);
        }
        x++;
        if (x > 30 && play) {
            x = 0;
            sensors.frame++;
        }
    }

    if (sensors.frame > 5) sensors.frame = 0;

    // ajustar el brillo
    FastLED.setBrightness(sensors.brightness*0.75);
    
    // mostrar info
    Serial.print("frame: ");
    Serial.print(sensors.frame);
    Serial.print(" - brillo: ");
    Serial.print(sensors.brightness);
    Serial.print(" ");
    Serial.println(x);
        
    // mostrar imagen
    FastLED.show();
}
